## config/west.yml
```yaml
manifest:
  remotes:
    - name: zmkfirmware
      url-base: https://github.com/zmkfirmware
    - name: urob
      url-base: https://github.com/urob
    - name: AakashDabas
      url-base: https://github.com/AakashDabas
    - name: marschelloss
      url-base: https://github.com/Marschelloss
  projects:
    # - name: zmk
    #   remote: AakashDabas
    #   revision: animated_widgets
    #   import: app/west.yml
    - name: zmk
      remote: marschelloss
      revision: pr2027-updated
      import: app/west.yml
    # - name: zmk
    #   remote: urob
    #   revision: main
    #   import: app/west.yml
  self:
    path: config
```
